## CMakeLists.txt
```
cmake_minimum_required(VERSION 3.20.0)
find_package(Zephyr REQUIRED HINTS $ENV{ZEPHYR_BASE})
project(lora_star_radio_test)

target_sources(app PRIVATE src/main.c)
target_include_directories(app PRIVATE ${CMAKE_CURRENT_SOURCE_DIR}/../../../subsys/lora_star)
```

## prj.conf
```kconfig
CONFIG_ZTEST=y

CONFIG_LORA=y
CONFIG_LORA_STAR=y

CONFIG_MBEDTLS=y
CONFIG_MBEDTLS_BUILTIN=y
CONFIG_PSA_CRYPTO=y

CONFIG_SETTINGS=y
CONFIG_SETTINGS_RUNTIME=y

CONFIG_ENTROPY_GENERATOR=y

CONFIG_MINIMAL_LIBC=y
CONFIG_COMMON_LIBC_MALLOC_ARENA_SIZE=2048
CONFIG_HEAP_MEM_POOL_SIZE=2084
```

## src/main.c
```c
/*
 * Copyright (c) 2026 Alexandre Bailon <abailon@baylibre.com>
 * SPDX-License-Identifier: Apache-2.0
 */

#include <zephyr/ztest.h>
#include <string.h>
#include <zephyr/drivers/lora.h>
#include <zephyr/drivers/lora_fake.h>
#include <lora_star/mac.h>

#include "event.h"

static uint8_t test_buf[64] = {
	0x12, 0x45, 0x11, 0x74,
};

static struct ls_ctx ctx;
static struct ls_event test_msgq_buf[CONFIG_LORA_STAR_MSGQ_DEPTH];
static struct k_msgq test_msgq;

static void mac_before(void *fixture)
{
	ARG_UNUSED(fixture);
	lora_fake_reset();
	memset(&ctx, 0, sizeof(ctx));
	ctx.radio_dev = lora_fake_get_device();
	k_msgq_init(&test_msgq, (char *)test_msgq_buf, sizeof(struct ls_event),
		     CONFIG_LORA_STAR_MSGQ_DEPTH);
	ctx._msgq = &test_msgq;
	k_mutex_init(&ctx._handlers_lock);
}

/* --------------------------------------------------------------------------
 * ls_mac_init
 * -------------------------------------------------------------------------- */

ZTEST(lora_star_mac, test_ls_mac_init)
{
	int ret;

	ret = ls_mac_init(&ctx);

	zassert_equal(ret, 0);
	zassert_equal(lora_fake_config_fake.call_count, 1);
}

/* --------------------------------------------------------------------------
 * ls_mac_send
 * -------------------------------------------------------------------------- */

ZTEST(lora_star_mac, test_ls_mac_send)
{
	static const uint8_t key[LS_NETWORK_KEY_SIZE] = {
		0x01, 0x02, 0x03, 0x04, 0x05, 0x06, 0x07, 0x08,
		0x09, 0x0A, 0x0B, 0x0C, 0x0D, 0x0E, 0x0F, 0x10,
	};
	struct ls_frame frame = {
		.payload_len = 0,
	};
	const uint8_t *sent_data;
	uint32_t sent_data_len;
	int ret;

	ret = ls_mac_send(&ctx, &frame, key);
	sent_data = lora_fake_get_sent_data(&sent_data_len);

	zassert_equal(ret, 0);
	zassert_equal(sent_data_len, LS_FRAME_SIZE(frame.payload_len));
	zassert_mem_equal(sent_data, frame.buf, sent_data_len);
}

ZTEST(lora_star_mac, test_ls_mac_send_null_key)
{
	struct ls_frame frame = {
		.payload_len = 0,
	};
	int ret;

	ret = ls_mac_send(&ctx, &frame, NULL);

	zassert_equal(ret, -EINVAL);
}

ZTEST(lora_star_mac, test_ls_mac_send_null_ctx)
{
	int ret;

	ret = ls_mac_send(NULL, NULL, NULL);

	zassert_equal(ret, -ENODEV);
}

ZTEST(lora_star_mac, test_ls_mac_send_null_device)
{
	struct ls_ctx no_dev_ctx = { .radio_dev = NULL };
	int ret;

	ret = ls_mac_send(&no_dev_ctx, NULL, NULL);

	zassert_equal(ret, -ENODEV);
}

ZTEST(lora_star_mac, test_ls_mac_send_null_frame)
{
	int ret;

	ret = ls_mac_send(&ctx, NULL, NULL);

	zassert_equal(ret, -EINVAL);
}

/* --------------------------------------------------------------------------
 * ls_mac_recv / ls_mac_rx_stop
 * -------------------------------------------------------------------------- */

ZTEST(lora_star_mac, test_ls_mac_recv_null_ctx)
{
	int ret;

	ret = ls_mac_recv(NULL);

	zassert_equal(ret, -ENODEV);
}

ZTEST(lora_star_mac, test_ls_mac_recv_null_device)
{
	struct ls_ctx no_dev_ctx = { .radio_dev = NULL };
	int ret;

	ret = ls_mac_recv(&no_dev_ctx);

	zassert_equal(ret, -ENODEV);
}

ZTEST(lora_star_mac, test_ls_mac_recv)
{
	struct ls_event ev;
	int ret;

	ret = ls_mac_recv(&ctx);
	zassert_equal(ret, 0);
	lora_fake_set_recv_data(test_buf, sizeof(test_buf), -70, 5);
	lora_fake_trigger_recv_async();
	ret = k_msgq_get(ctx._msgq, &ev, K_NO_WAIT);

	zassert_equal(ret, 0);
	zassert_equal(ev.type, LS_EVENT_RX);
	zassert_equal(LS_FRAME_SIZE(ev.rx.payload_len), sizeof(test_buf));
	zassert_mem_equal(ev.rx.buf, test_buf, sizeof(test_buf));
}

ZTEST(lora_star_mac, test_ls_mac_rx_stop_null_ctx)
{
	int ret;

	ret = ls_mac_rx_stop(NULL);

	zassert_equal(ret, -ENODEV);
}

ZTEST(lora_star_mac, test_ls_mac_rx_stop_null_device)
{
	struct ls_ctx no_dev_ctx = { .radio_dev = NULL };
	int ret;

	ret = ls_mac_rx_stop(&no_dev_ctx);

	zassert_equal(ret, -ENODEV);
}

ZTEST(lora_star_mac, test_ls_mac_rx_stop)
{
	struct ls_event ev;
	int ret;

	ls_mac_recv(&ctx);
	ls_mac_rx_stop(&ctx);
	k_msgq_purge(ctx._msgq);
	lora_fake_set_recv_data(test_buf, sizeof(test_buf), -70, 5);
	lora_fake_trigger_recv_async();
	ret = k_msgq_get(ctx._msgq, &ev, K_NO_WAIT);

	zassert_equal(ret, -ENOMSG);
}

/* --------------------------------------------------------------------------
 * ls_mac_airtime_ms
 * -------------------------------------------------------------------------- */

ZTEST(lora_star_mac, test_ls_mac_airtime_ms)
{
	uint32_t airtime;

	lora_fake_airtime_fake.return_val = 100;
	airtime = ls_mac_airtime_ms(&ctx, 64);

	zassert_equal(airtime, 100);
	zassert_equal(lora_fake_airtime_fake.arg1_val, 64);
}

ZTEST_SUITE(lora_star_mac, NULL, NULL, mac_before, NULL, NULL);
```
