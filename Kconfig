## drivers/lora/Kconfig
```kconfig
config LORA_FAKE
	bool "Fake LoRa driver for testing"
	depends on LORA
	help
	  Enable a fff-backed fake LoRa driver for use in unit tests.
	  Requires a DT node with compatible = "zephyr,lora-fake" and
	  status = "okay" in the board overlay.
```

## dts/bindings/zephyr,ls-pairing-button.yaml
```yaml
compatible: "zephyr,ls-pairing-button"
description: |
  Enable and configure the button for enabling pairing process
  for LoRa Star device or coordinator.

properties:
  gpios:
    type: phandle-array
    required: true
```

## subsys/lora_star/Kconfig
```kconfig
menu "LoRa Star Protocol"

config LORA_STAR
	bool "LoRa Star protocol library"
	depends on MBEDTLS
	depends on MBEDTLS_BUILTIN
	depends on PSA_CRYPTO
	depends on SETTINGS
	depends on ENTROPY_GENERATOR
	select PSA_WANT_ALG_ECDH
	select PSA_WANT_ECC_MONTGOMERY_255
	select PSA_WANT_KEY_TYPE_ECC_KEY_PAIR_GENERATE
	select PSA_WANT_KEY_TYPE_ECC_KEY_PAIR_IMPORT
	select PSA_WANT_KEY_TYPE_ECC_KEY_PAIR_EXPORT
	select PSA_WANT_ALG_HKDF
	select PSA_WANT_ALG_SHA_256
	select PSA_WANT_KEY_TYPE_DERIVE
	select PSA_WANT_ALG_CTR
	select PSA_WANT_KEY_TYPE_AES
	select PSA_WANT_ALG_CMAC
	help
	  Enable the LoRa Star custom star-topology protocol library.
	  The Settings subsystem handles persistent state; choose a backend
	  (CONFIG_SETTINGS_ZMS, CONFIG_SETTINGS_NVS, …) in your application.

if LORA_STAR

choice LORA_STAR_ROLE
	prompt "LoRa Star device role"
	depends on LORA
	default LORA_STAR_ROLE_COORDINATOR
	help
	  Select which role(s) this device builds.  Exactly one coordinator
	  runs per network; every other device pairs with it as a node.

config LORA_STAR_ROLE_COORDINATOR
	bool "Coordinator role"
	select LORA_STAR_COORDINATOR
	help
	  Build only the coordinator state machine.

config LORA_STAR_ROLE_NODE
	bool "Node role"
	depends on HWINFO
	select LORA_STAR_NODE
	help
	  Build only the node state machine.

config LORA_STAR_ROLE_DUAL
	bool "Dual role (coordinator + node)"
	depends on HWINFO
	select LORA_STAR_COORDINATOR
	select LORA_STAR_NODE
	help
	  Build both the coordinator and node state machines into the same
	  firmware image.  Useful for test rigs where the active role is
	  chosen at runtime.

endchoice

config LORA_STAR_COORDINATOR
	bool
	depends on LORA
	help
	  Include the coordinator state machine.  Exactly one device in the
	  network runs as coordinator.  Enabled via LORA_STAR_ROLE.

config LORA_STAR_NODE
	bool
	depends on LORA
	depends on HWINFO
	help
	  Include the node state machine.  Enabled via LORA_STAR_ROLE.

config LORA_STAR_PAIRING
	bool "Enable pairing support"
	depends on (LORA_STAR_COORDINATOR || LORA_STAR_NODE)
	help
	  Include logic for pairing a node with a coordinator
	  securely by using asymetric encryption for exchanging
	  the network key.

if LORA_STAR_PAIRING

config LORA_STAR_PAIRING_WINDOW_S
	int "Pairing window duration (seconds)"
	default 10

config LORA_STAR_PAIRING_RSSI_THRESHOLD_DBM
	int "Minimum RSSI for JOIN_REQ acceptance (dBm)"
	default -60

config LORA_STAR_PAIRING_CRYPTO_GUARD_MS
	int "Extra guard time for coordinator ECDH processing during pairing (ms)"
	default 1000
	help
	  After transmitting a JOIN_REQ the node waits for a JOIN_ACCEPT for
	  airtime(JOIN_ACCEPT) + ACK_GUARD_MS + this value.  The extra guard
	  covers the coordinator's ECDH key agreement computation, which takes
	  200-500 ms in software on a typical Cortex-M MCU.  Increase if pairing
	  consistently times out on slow hardware.

config LORA_STAR_PAIRING_BUTTON
	bool "GPIO-triggered pairing button"
	depends on GPIO
	help
	  Start pairing from a devicetree-configured GPIO button, with no
	  application code required: the coordinator opens a pairing window
	  and the node broadcasts a JOIN_REQ when the button is pressed.
	  Requires a devicetree node with compatible = "lora_star,pairing-button"
	  and a "gpios" phandle to the button GPIO.

endif

config LORA_STAR_DEFAULT_NETWORK_KEY
	bool "Use a compile-time default network key"
	help
	  When enabled, the stack loads LORA_STAR_DEFAULT_NETWORK_KEY_VALUE as
	  the network key on every boot if Settings contains no persisted key.
	  Useful for fixed deployments where all devices share a pre-configured
	  key without going through the pairing procedure.  The Settings key
	  always takes precedence when present.

if LORA_STAR_DEFAULT_NETWORK_KEY

config LORA_STAR_DEFAULT_NETWORK_KEY_VALUE
	string "Default network key (32 lowercase hex characters)"
	default "00112233445566778899aabbccddeeff"
	help
	  16-byte network key encoded as exactly 32 lowercase hexadecimal
	  characters.  Change this value to a secret key before deploying.

endif # LORA_STAR_DEFAULT_NETWORK_KEY

config LORA_STAR_MAX_NODES
	int "Maximum number of paired nodes (coordinator)"
	default 16
	depends on LORA_STAR_COORDINATOR
	help
	  Size of the in-RAM node table.  Each entry is ~30 bytes.

config LORA_STAR_ACK_GUARD_MS
	int "Guard time added to the ACK timeout on top of computed airtime (ms)"
	default 100
	help
	  After transmitting a DATA frame, the node waits for an ACK for
	  airtime(data) + airtime(ack) + this guard.  The guard covers the
	  receiver's processing and TX-switch latency.

config LORA_STAR_TX_MAX_RETRIES
	int "Maximum uplink retries before reporting failure"
	default 3

config LORA_STAR_TX_RETRY_BACKOFF_MS
	int "Base backoff between retries (ms); uniform jitter [0,base) added"
	default 500

config LORA_STAR_FCNT_REBOOT_INCREMENT
	int "Frame counter guard increment on reboot"
	default 32
	help
	  After a reboot, FCNT is restored from Settings then incremented by
	  this value to account for frames sent before the last save. FCNT is
	  also flushed to Settings every time it advances by this many counts
	  (see ls_mac_send()), so the two uses must share one value: the save
	  threshold bounds how far FCNT can be ahead of the persisted value at
	  any moment, and the reboot guard must cover exactly that same gap.

config LORA_STAR_FREQUENCY
	int "LoRa carrier frequency (Hz)"
	default 868100000

config LORA_STAR_TX_POWER_DBM
	int "LoRa TX power (dBm)"
	default 14

config LORA_STAR_MSGQ_DEPTH
	int "Unified event queue depth"
	default 8
	help
	  Number of events (received frames, TX commands, and timeout
	  notifications) that can be buffered in the shared protocol queue.
	  Increase if high traffic causes frames to be dropped.

config LORA_STAR_MAX_FRAME_CBS
	int "Maximum number of registered frame callbacks"
	default 5
	help
	  Size of the static callback registry.  Slots are consumed by
	  pairing handlers and application data handlers.

config LORA_STAR_THREAD_STACK_SIZE
	int "Protocol thread stack size (bytes)"
	default 2048
	help
	  Stack for the single LoRa Star protocol thread.  Must be large enough
	  to cover the full radio TX/RX call stack including AES-CTR/CMAC and
	  lora_send/lora_recv_async.  Increase if stack overflow is observed.

config LORA_STAR_THREAD_PRIORITY
	int "Protocol thread priority"
	default 5
	help
	  Must be a preemptive priority (>= 0) so the system workqueue thread
	  remains free to service the LoRa radio DIO1 IRQ work item while the
	  protocol thread is blocked in lora_send().

module = LORA_STAR
module-str = lora_star
source "subsys/logging/Kconfig.template.log_config"

endif # LORA_STAR

endmenu
```

## tests/unit/lora_star/testcase.yaml
```yaml
common:
  tags:
    - lora_star
  platform_allow:
    - native_sim
    - native_sim/native/64
  integration_platforms:
    - native_sim
tests:
  lora_star.unit.lora_star: {}
```

## west.yml
```yaml
manifest:
  projects:
    - name: zephyr
      url: https://github.com/zephyrproject-rtos/zephyr
      revision: main
      import: true

  self:
    path: lora-star
```
