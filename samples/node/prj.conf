## CMakeLists.txt
```
cmake_minimum_required(VERSION 3.20.0)
find_package(Zephyr REQUIRED HINTS $ENV{ZEPHYR_BASE})
project(lora_star_node)

target_sources(app PRIVATE src/main.c)
```

## sample.yaml
```
common:
  tags:
    - lora_star
  platform_allow:
    - lora_e5_dev_board
  integration_platforms:
    - lora_e5_dev_board
  build_only: true
tests:
  sample.lora_star.node: {}
```

## prj.conf
```kconfig
# LoRa Star library
CONFIG_LORA_STAR=y
CONFIG_LORA_STAR_ROLE_NODE=y
CONFIG_LORA_STAR_PAIRING=y
CONFIG_LORA_STAR_PAIRING_BUTTON=y

# LoRa radio driver
CONFIG_LORA=y

# Crypto — PSA Crypto API backed by mbedTLS
CONFIG_MBEDTLS=y
CONFIG_MBEDTLS_BUILTIN=y
CONFIG_PSA_CRYPTO=y
# ECDH / Curve25519 (X25519)
CONFIG_PSA_WANT_ALG_ECDH=y
CONFIG_PSA_WANT_ECC_MONTGOMERY_255=y
CONFIG_PSA_WANT_KEY_TYPE_ECC_KEY_PAIR_GENERATE=y
CONFIG_PSA_WANT_KEY_TYPE_ECC_KEY_PAIR_IMPORT=y
CONFIG_PSA_WANT_KEY_TYPE_ECC_KEY_PAIR_EXPORT=y
# HKDF-SHA256
CONFIG_PSA_WANT_ALG_HKDF=y
CONFIG_PSA_WANT_ALG_SHA_256=y
CONFIG_PSA_WANT_KEY_TYPE_DERIVE=y
# AES-128-CTR
CONFIG_PSA_WANT_ALG_CTR=y
CONFIG_PSA_WANT_KEY_TYPE_AES=y
# AES-CMAC
CONFIG_PSA_WANT_ALG_CMAC=y

# Persistent settings (backend chosen per board)
CONFIG_SETTINGS=y
CONFIG_SETTINGS_ZMS=y
CONFIG_ZMS=y
CONFIG_FLASH=y
CONFIG_FLASH_MAP=y

# Hardware ID and entropy
CONFIG_HWINFO=y
CONFIG_ENTROPY_GENERATOR=y

# GPIO (pairing button)
CONFIG_GPIO=y

# Logging
CONFIG_LOG=y

# Avoid picolibc ABI mismatch between Zephyr 4.1.0 and SDK 0.17.x
CONFIG_MINIMAL_LIBC=y
CONFIG_COMMON_LIBC_MALLOC_ARENA_SIZE=2048
CONFIG_MAIN_STACK_SIZE=8192
CONFIG_HEAP_MEM_POOL_SIZE=2084
CONFIG_SYSTEM_WORKQUEUE_STACK_SIZE=4096
```

## src/main.c
```c
/*
 * Copyright (c) 2026 Alexandre Bailon <abailon@baylibre.com>
 * SPDX-License-Identifier: Apache-2.0
 */

#include <stdio.h>

#include <zephyr/kernel.h>
#include <zephyr/device.h>
#include <zephyr/logging/log.h>

#include <lora_star/lora_star.h>
#include <lora_star/pairing.h>
#include <lora_star/pairing_button.h>

LOG_MODULE_REGISTER(node_sample, LOG_LEVEL_INF);

static struct ls_ctx *ctx;

static void on_pairing_done(struct ls_ctx *ls, int result, void *user_data)
{
	ARG_UNUSED(user_data);

	if (result < 0) {
		LOG_WRN("Pairing failed: %d", result);
	} else {
		LOG_INF("Paired — ShortAddr 0x%04x", ls->own_addr);
	}
}

int main(void)
{
	const struct device *lora_dev = DEVICE_DT_GET(DT_ALIAS(lora0));
	uint32_t counter = 0;
	char msg[32];
	int n, ret;

	ctx = ls_init(lora_dev);
	if (!ctx) {
		LOG_ERR("ls_init failed");
		return -EIO;
	}

	ls_pairing_button_set_done_cb(on_pairing_done, NULL);

	if (ls_is_paired(ctx)) {
		LOG_INF("Session restored — ShortAddr 0x%04x", ctx->own_addr);
	} else {
		LOG_INF("Not paired — press button to start pairing");
	}

	LOG_INF("Node ready");

	while (true) {
		k_sleep(K_SECONDS(30));

		if (!ls_is_paired(ctx)) {
			LOG_WRN("Not paired, skipping uplink");
			continue;
		}

		n = snprintf(msg, sizeof(msg), "ping %u", counter++);
		ret = ls_send_data_ack(ctx, LS_COORD_ADDR, (const uint8_t *)msg, n);
		if (ret < 0) {
			LOG_WRN("Send failed: %d", ret);
		} else {
			LOG_INF("Sent and ACKed: %s", msg);
		}
	}

	return 0;
}
```
