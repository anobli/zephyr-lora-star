## CMakeLists.txt
```
cmake_minimum_required(VERSION 3.20.0)
find_package(Zephyr REQUIRED HINTS $ENV{ZEPHYR_BASE})
project(lora_star_link_test)

target_sources(app PRIVATE src/main.c)
```

## Kconfig
```
mainmenu "LoRa Star Link Test Sample"

choice LORA_STAR_LINK_TEST_ROLE
	prompt "Device role"
	default LORA_STAR_LINK_TEST_NODE

config LORA_STAR_LINK_TEST_COORDINATOR
	bool "Coordinator"
	help
	  Build as the link-test coordinator.  Sends periodic DATA frames with
	  ACK_REQ to the paired node and tracks delivery statistics
	  (error% and retry%).

config LORA_STAR_LINK_TEST_NODE
	bool "Node"
	help
	  Build as the link-test node.  Stays in continuous receive and sends an
	  ACK for every DATA frame that carries LS_FLAG_ACK_REQ.

endchoice

config LORA_STAR_LINK_TEST_PERIOD_S
	int "Coordinator transmit interval (seconds)"
	default 5
	range 1 3600
	depends on LORA_STAR_LINK_TEST_COORDINATOR
	help
	  How often the coordinator sends a new DATA frame to the node.

config LORA_STAR_LINK_TEST_MAX_RETRIES
	int "Application-level retry limit per packet"
	default 3
	range 1 10
	depends on LORA_STAR_LINK_TEST_COORDINATOR
	help
	  Maximum number of retry attempts per packet before the coordinator
	  counts it as lost.  Each retry is a fresh ls_send_data_ack_async()
	  call.  CONFIG_LORA_STAR_TX_MAX_RETRIES must be 0 (set in prj.conf)
	  so every individual attempt is visible to the application.

config LORA_STAR_LINK_TEST_STATS_S
	int "Statistics log interval (seconds)"
	default 60
	range 10 3600
	depends on LORA_STAR_LINK_TEST_COORDINATOR
	help
	  How often the coordinator logs the current error% and retry%
	  counters.  The counters accumulate for the entire run, so the
	  percentages represent lifetime averages.

source "Kconfig.zephyr"
```

## sample.yaml
```
common:
  tags:
    - lora_star
  platform_allow:
    - lora_e5_dev_board
  integration_platforms:
    - lora_e5_dev_board
  build_only: true
tests:
  sample.lora_star.link_test.node: {}
  sample.lora_star.link_test.coordinator:
    extra_configs:
      - CONFIG_LORA_STAR_LINK_TEST_COORDINATOR=y
```

## prj.conf
```kconfig
# LoRa Star library — compile both roles; role selected at build time via Kconfig
CONFIG_LORA_STAR=y
CONFIG_LORA_STAR_ROLE_DUAL=y
CONFIG_LORA_STAR_PAIRING=y
CONFIG_LORA_STAR_PAIRING_BUTTON=y

# Disable stack-level retries so the application has full visibility of each
# individual attempt and can track retry statistics accurately.
CONFIG_LORA_STAR_TX_MAX_RETRIES=0

# LoRa radio driver (board-specific; enable the matching driver)
CONFIG_LORA=y

# Crypto — PSA Crypto API backed by mbedTLS
CONFIG_MBEDTLS=y
CONFIG_MBEDTLS_BUILTIN=y
CONFIG_PSA_CRYPTO=y
# ECDH / Curve25519 (X25519)
CONFIG_PSA_WANT_ALG_ECDH=y
CONFIG_PSA_WANT_ECC_MONTGOMERY_255=y
CONFIG_PSA_WANT_KEY_TYPE_ECC_KEY_PAIR_GENERATE=y
CONFIG_PSA_WANT_KEY_TYPE_ECC_KEY_PAIR_IMPORT=y
CONFIG_PSA_WANT_KEY_TYPE_ECC_KEY_PAIR_EXPORT=y
# HKDF-SHA256
CONFIG_PSA_WANT_ALG_HKDF=y
CONFIG_PSA_WANT_ALG_SHA_256=y
CONFIG_PSA_WANT_KEY_TYPE_DERIVE=y
# AES-128-CTR
CONFIG_PSA_WANT_ALG_CTR=y
CONFIG_PSA_WANT_KEY_TYPE_AES=y
# AES-CMAC
CONFIG_PSA_WANT_ALG_CMAC=y

# Persistent settings
CONFIG_SETTINGS=y
CONFIG_SETTINGS_ZMS=y
CONFIG_SETTINGS_RUNTIME=y
CONFIG_ZMS=y
CONFIG_FLASH=y
CONFIG_FLASH_MAP=y

# Hardware ID and entropy
CONFIG_HWINFO=y
CONFIG_ENTROPY_GENERATOR=y

# GPIO for pairing button
CONFIG_GPIO=y

# Power management — both roles idle-block on a single event queue
# (k_msgq_get K_FOREVER), so the CPU is free to enter the deepest SoC sleep
# state between LoRa IRQs, button presses and periodic timers.  On
# lora_e5_dev_board this reaches STM32 STOP0/1/2. Runtime device PM lets the
# console UART suspend between log lines instead of staying clocked.
#CONFIG_PM=y
#CONFIG_PM_DEVICE=y
#CONFIG_PM_DEVICE_RUNTIME=y

# Logging
CONFIG_LOG=y
CONFIG_LORA_STAR_LOG_LEVEL_INF=y

# Avoid picolibc ABI mismatch between Zephyr 4.1.0 and SDK 0.17.x
CONFIG_MINIMAL_LIBC=y
CONFIG_COMMON_LIBC_MALLOC_ARENA_SIZE=2048
CONFIG_MAIN_STACK_SIZE=2048
CONFIG_SYSTEM_WORKQUEUE_STACK_SIZE=2048
CONFIG_HEAP_MEM_POOL_SIZE=2048
```

## boards/lora_e5_dev_board.overlay
```dts
/*
 * Pairing button, bound to the same physical pin as the "sw0" alias
 * (boot_button, PB13) so pressing SW1 on the board starts pairing.
 */
/ {
	pairing-button {
		compatible = "lora_star,pairing-button";
		gpios = <&gpiob 13 (GPIO_ACTIVE_LOW | GPIO_PULL_UP)>;
	};
};
```

## src/main.c
```c
/*
 * Copyright (c) 2026 Alexandre Bailon <abailon@baylibre.com>
 * SPDX-License-Identifier: Apache-2.0
 */

/*
 * link_test — LoRa Star reliability test: coordinator periodically pings a
 * node with ACK_REQ frames and tracks delivery statistics.
 *
 * Role is selected at build time:
 *   CONFIG_LORA_STAR_LINK_TEST_COORDINATOR=y  →  sends DATA + tracks stats
 *   CONFIG_LORA_STAR_LINK_TEST_NODE=y          →  ACKs every DATA received
 *
 * Both roles use the devicetree-configured pairing button (SW0) to trigger
 * pairing; see subsys/lora_star/pairing_button.c. Pairing only hands the
 * node the long-term network key — ls_init() then automatically runs the
 * rejoin handshake (lora_star/rejoin.h) to establish the session key
 * DATA/ACK traffic actually uses, and re-runs it on every reboot. Expect a
 * short window after boot/pairing where sends fail with -ENOTCONN until
 * that completes.
 *
 * Coordinator behaviour:
 *   Every PERIOD_S, sends a DATA frame with ACK_REQ to the paired node.  On
 *   timeout the application retries up to MAX_RETRIES times (the LoRa Star
 *   stack has TX_MAX_RETRIES=0 so every attempt is visible here).  Every
 *   STATS_S the coordinator logs lifetime error% and retry%.
 *
 * Node behaviour:
 *   Stays in continuous RX.  Calls ls_send_ack() for every DATA frame
 *   carrying LS_FLAG_ACK_REQ, and toggles led0 (if present) on every DATA
 *   frame received — a visual "still in range" indicator for range testing
 *   without a serial console.
 *
 * Statistics definitions (coordinator only):
 *   sent   — distinct packets initiated (retries of the same packet are not
 *             counted again here)
 *   errors — packets that were lost after all retry attempts
 *   retried — packets that needed at least one retry (but may still have
 *              been delivered eventually)
 *   error%  = errors  * 100 / sent
 *   retry%  = retried * 100 / sent
 */

#include <zephyr/kernel.h>
#include <zephyr/device.h>
#include <zephyr/drivers/gpio.h>
#include <zephyr/logging/log.h>
#include <lora_star/lora_star.h>
#include <lora_star/mac.h>
#include <lora_star/coord.h>
#include <lora_star/pairing.h>
#include <lora_star/pairing_button.h>

LOG_MODULE_REGISTER(link_test, LOG_LEVEL_INF);

static struct ls_ctx *g_ctx;

/* -------------------------------------------------------------------------
 * Coordinator
 * ------------------------------------------------------------------------- */

#if IS_ENABLED(CONFIG_LORA_STAR_LINK_TEST_COORDINATOR)

/*
 * LS_BCAST_ADDR is used as a sentinel meaning "no node paired yet".
 * Node addresses are in [LS_ADDR_MIN, LS_ADDR_MAX] so 0xFFFF is never valid.
 */
static uint16_t g_node_addr = LS_BCAST_ADDR;

static struct {
	uint32_t sent;        /* new packets initiated */
	uint32_t errors;      /* packets lost after all retries */
	uint32_t retried;     /* packets needing at least one retry */
	uint8_t  cur_retries; /* retry count for the current in-flight packet */
} g_stats;

static struct k_work_delayable g_send_work;
static struct k_work           g_retry_work;
static struct k_work_delayable g_stats_work;

static void send_packet(void);

static void on_send_done(int ret, void *user_data)
{
	ARG_UNUSED(user_data);

	if (ret == 0) {
		k_work_schedule(&g_send_work,
				K_SECONDS(CONFIG_LORA_STAR_LINK_TEST_PERIOD_S));
	} else {
		k_work_submit(&g_retry_work);
	}
}

static void send_packet(void)
{
	uint8_t data[2];
	int ret;

	data[0] = (uint8_t)(g_stats.sent & 0xFF);
	data[1] = g_stats.cur_retries;

	ret = ls_send_data_ack_async(g_ctx, g_node_addr, data, sizeof(data),
				     on_send_done, NULL);
	if (ret < 0) {
		LOG_WRN("Enqueue failed: %d — rescheduling", ret);
		k_work_schedule(&g_send_work, K_SECONDS(1));
	}
}

static void retry_work_fn(struct k_work *work)
{
	ARG_UNUSED(work);

	/*
	 * Increment retried once per packet (not once per retry attempt) so
	 * the counter reflects packets that needed help, not total attempts.
	 */
	if (g_stats.cur_retries == 0) {
		g_stats.retried++;
	}
	g_stats.cur_retries++;

	if (g_stats.cur_retries <= CONFIG_LORA_STAR_LINK_TEST_MAX_RETRIES) {
		LOG_WRN("Packet 0x%02x: retry %u/%u",
			(uint8_t)(g_stats.sent & 0xFF),
			g_stats.cur_retries,
			CONFIG_LORA_STAR_LINK_TEST_MAX_RETRIES);
		send_packet();
	} else {
		g_stats.errors++;
		LOG_ERR("Packet 0x%02x: lost after %d retries",
			(uint8_t)(g_stats.sent & 0xFF),
			CONFIG_LORA_STAR_LINK_TEST_MAX_RETRIES);
		k_work_schedule(&g_send_work,
				K_SECONDS(CONFIG_LORA_STAR_LINK_TEST_PERIOD_S));
	}
}

static void send_work_fn(struct k_work *work)
{
	ARG_UNUSED(work);

	if (g_node_addr == LS_BCAST_ADDR) {
		/* No node paired yet; poll until one joins. */
		k_work_schedule(&g_send_work, K_SECONDS(1));
		return;
	}

	g_stats.sent++;
	g_stats.cur_retries = 0;
	send_packet();
}

static void stats_work_fn(struct k_work *work)
{
	uint32_t sent    = g_stats.sent;
	uint32_t errors  = g_stats.errors;
	uint32_t retried = g_stats.retried;

	ARG_UNUSED(work);

	if (sent == 0) {
		LOG_INF("link_test stats: no packets sent yet");
	} else {
		LOG_INF("link_test stats: sent=%u  error=%u (%u%%)  retry=%u (%u%%)",
			sent,
			errors,  errors  * 100U / sent,
			retried, retried * 100U / sent);
	}

	k_work_schedule(&g_stats_work,
			K_SECONDS(CONFIG_LORA_STAR_LINK_TEST_STATS_S));
}

static void coord_on_join(struct ls_ctx *ls, uint16_t short_addr,
			   const uint8_t dev_eui[LS_DEV_EUI_SIZE],
			   void *user_data)
{
	ARG_UNUSED(ls);
	ARG_UNUSED(user_data);

	LOG_INF("Node joined: addr=0x%04x EUI=%02x%02x%02x%02x%02x%02x%02x%02x",
		short_addr,
		dev_eui[0], dev_eui[1], dev_eui[2], dev_eui[3],
		dev_eui[4], dev_eui[5], dev_eui[6], dev_eui[7]);

	if (g_node_addr == LS_BCAST_ADDR) {
		g_node_addr = short_addr;
		LOG_INF("P2P peer set to 0x%04x — link test active", g_node_addr);
	} else {
		LOG_WRN("Second node 0x%04x ignored (P2P mode; only one peer supported)",
			short_addr);
	}
}

static int coord_init(const struct device *lora_dev)
{
	struct ls_coord_ctx *coord;
	int i;
	int ret;

	g_ctx = ls_init(lora_dev);
	if (!g_ctx) {
		LOG_ERR("ls_init failed");
		return -EIO;
	}

	ret = ls_init_coord(g_ctx);
	if (ret < 0) {
		LOG_ERR("ls_init_coord failed: %d", ret);
		return ret;
	}

	ls_pairing_button_set_join_cb(coord_on_join, NULL);

	/* Restore peer address from a previous session if available. */
	coord = ls_coord_get();
	for (i = 0; i < CONFIG_LORA_STAR_MAX_NODES; i++) {
		if (coord->nodes[i].active) {
			g_node_addr = coord->nodes[i].short_addr;
			LOG_INF("Restored peer 0x%04x from storage — link test active",
				g_node_addr);
			break;
		}
	}

	k_work_init(&g_retry_work, retry_work_fn);
	k_work_init_delayable(&g_send_work, send_work_fn);
	k_work_init_delayable(&g_stats_work, stats_work_fn);

	k_work_schedule(&g_send_work,
			K_SECONDS(CONFIG_LORA_STAR_LINK_TEST_PERIOD_S));
	k_work_schedule(&g_stats_work,
			K_SECONDS(CONFIG_LORA_STAR_LINK_TEST_STATS_S));

	return 0;
}

#endif /* CONFIG_LORA_STAR_LINK_TEST_COORDINATOR */

/* -------------------------------------------------------------------------
 * Node
 * ------------------------------------------------------------------------- */

#if IS_ENABLED(CONFIG_LORA_STAR_LINK_TEST_NODE)

#if DT_NODE_EXISTS(DT_ALIAS(led0))
static const struct gpio_dt_spec status_led = GPIO_DT_SPEC_GET(DT_ALIAS(led0), gpios);
#define HAVE_STATUS_LED 1
#else
#define HAVE_STATUS_LED 0
#endif

static void node_pairing_done(struct ls_ctx *ctx, int result, void *user_data)
{
	ARG_UNUSED(ctx);
	ARG_UNUSED(user_data);

	if (result < 0) {
		LOG_WRN("Pairing failed: %d", result);
	} else {
		LOG_INF("Pairing succeeded");
	}
}

static int node_on_recv(struct ls_ctx *ctx, struct ls_frame *frame,
			void *user_data)
{
	uint8_t flags;

	ARG_UNUSED(user_data);

	flags = ls_frame_get_flags(frame);
	if (flags & LS_FLAG_ACK_REQ) {
		ls_send_ack(ctx, ls_frame_get_src(frame));
	}

#if HAVE_STATUS_LED
	gpio_pin_toggle_dt(&status_led);
#endif

	return 0;
}

static int node_init(const struct device *lora_dev)
{
	g_ctx = ls_init(lora_dev);
	if (!g_ctx) {
		LOG_ERR("ls_init failed");
		return -EIO;
	}

	ls_pairing_button_set_done_cb(node_pairing_done, NULL);

#if HAVE_STATUS_LED
	if (device_is_ready(status_led.port)) {
		gpio_pin_configure_dt(&status_led, GPIO_OUTPUT_INACTIVE);
		LOG_INF("led0 ready — will toggle on every received frame");
	} else {
		LOG_WRN("led0 not ready");
	}
#else
	LOG_INF("led0 not available on this board — no RX indicator");
#endif

	/*
	 * The node stays in continuous RX so it can receive coordinator
	 * downlinks at any time.  ls_mac_send() (called by ls_send_ack())
	 * automatically stops and restarts RX around each transmission
	 * because always_on_rx is true.
	 */
	g_ctx->always_on_rx = true;
	ls_register_data_cb(g_ctx, LS_BCAST_ADDR, node_on_recv, NULL);
	ls_mac_recv(g_ctx);

	return 0;
}

#endif /* CONFIG_LORA_STAR_LINK_TEST_NODE */

/* -------------------------------------------------------------------------
 * Main
 * ------------------------------------------------------------------------- */

int main(void)
{
	const struct device *lora_dev = DEVICE_DT_GET(DT_ALIAS(lora0));
	int ret;

	LOG_INF("link_test starting as %s",
		IS_ENABLED(CONFIG_LORA_STAR_LINK_TEST_COORDINATOR)
		? "COORDINATOR" : "NODE");

	/* Tell the pairing-button driver which role to trigger on press. */
	ls_pairing_button_set_role(IS_ENABLED(CONFIG_LORA_STAR_LINK_TEST_COORDINATOR));

#if IS_ENABLED(CONFIG_LORA_STAR_LINK_TEST_COORDINATOR)
	ret = coord_init(lora_dev);
#else
	ret = node_init(lora_dev);
#endif
	if (ret < 0) {
		return ret;
	}

	LOG_INF("link_test ready");
	return 0;
}
```
