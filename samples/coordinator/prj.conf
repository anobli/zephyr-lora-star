## CMakeLists.txt
```
cmake_minimum_required(VERSION 3.20.0)
find_package(Zephyr REQUIRED HINTS $ENV{ZEPHYR_BASE})
project(lora_star_coordinator)

target_sources(app PRIVATE src/main.c)
```

## sample.yaml
```
common:
  tags:
    - lora_star
  platform_allow:
    - lora_e5_dev_board
  integration_platforms:
    - lora_e5_dev_board
  build_only: true
tests:
  sample.lora_star.coordinator: {}
```

## prj.conf
```kconfig
# LoRa Star library
CONFIG_LORA_STAR=y
CONFIG_LORA_STAR_ROLE_COORDINATOR=y
CONFIG_LORA_STAR_PAIRING=y
CONFIG_LORA_STAR_PAIRING_BUTTON=y

# LoRa radio driver (board-specific; enable the matching driver)
CONFIG_LORA=y

# Crypto — PSA Crypto API backed by mbedTLS
CONFIG_MBEDTLS=y
CONFIG_MBEDTLS_BUILTIN=y
CONFIG_PSA_CRYPTO=y
# ECDH / Curve25519 (X25519)
CONFIG_PSA_WANT_ALG_ECDH=y
CONFIG_PSA_WANT_ECC_MONTGOMERY_255=y
CONFIG_PSA_WANT_KEY_TYPE_ECC_KEY_PAIR_GENERATE=y
CONFIG_PSA_WANT_KEY_TYPE_ECC_KEY_PAIR_IMPORT=y
CONFIG_PSA_WANT_KEY_TYPE_ECC_KEY_PAIR_EXPORT=y
# HKDF-SHA256
CONFIG_PSA_WANT_ALG_HKDF=y
CONFIG_PSA_WANT_ALG_SHA_256=y
CONFIG_PSA_WANT_KEY_TYPE_DERIVE=y
# AES-128-CTR
CONFIG_PSA_WANT_ALG_CTR=y
CONFIG_PSA_WANT_KEY_TYPE_AES=y
# AES-CMAC
CONFIG_PSA_WANT_ALG_CMAC=y

# Persistent settings — pick one backend that matches the board's flash
CONFIG_SETTINGS=y
CONFIG_SETTINGS_ZMS=y

CONFIG_ZMS=y
CONFIG_FLASH=y
CONFIG_FLASH_MAP=y

# Hardware ID and entropy
CONFIG_HWINFO=y
CONFIG_ENTROPY_GENERATOR=y

# GPIO (pairing button)
CONFIG_GPIO=y

# Logging
CONFIG_LOG=y
CONFIG_LORA_STAR_LOG_LEVEL_DBG=y

# Avoid picolibc ABI mismatch between Zephyr 4.1.0 and SDK 0.17.x
CONFIG_MINIMAL_LIBC=y
CONFIG_COMMON_LIBC_MALLOC_ARENA_SIZE=2048
CONFIG_MAIN_STACK_SIZE=2048
CONFIG_HEAP_MEM_POOL_SIZE=2084
CONFIG_SYSTEM_WORKQUEUE_STACK_SIZE=2048
```

## src/main.c
```c
/*
 * Copyright (c) 2026 Alexandre Bailon <abailon@baylibre.com>
 * SPDX-License-Identifier: Apache-2.0
 */

#include <zephyr/kernel.h>
#include <zephyr/device.h>
#include <zephyr/logging/log.h>

#include <lora_star/lora_star.h>
#include <lora_star/mac.h>
#include <lora_star/coord.h>
#include <lora_star/pairing.h>
#include <lora_star/pairing_button.h>

LOG_MODULE_REGISTER(coord_sample, LOG_LEVEL_INF);

static struct ls_ctx *ctx;

/* --------------------------------------------------------------------------
 * Application callbacks
 * -------------------------------------------------------------------------- */

static void on_join(struct ls_ctx *ls, uint16_t short_addr,
		    const uint8_t dev_eui[LS_DEV_EUI_SIZE], void *user_data)
{
	ARG_UNUSED(ls);
	ARG_UNUSED(user_data);

	LOG_INF("New node: addr=0x%04x EUI=%02x%02x%02x%02x%02x%02x%02x%02x",
		short_addr,
		dev_eui[0], dev_eui[1], dev_eui[2], dev_eui[3],
		dev_eui[4], dev_eui[5], dev_eui[6], dev_eui[7]);
}

static int on_data(struct ls_ctx *ls, struct ls_frame *frame, void *user_data)
{
	uint8_t *payload;
	size_t payload_len;
	uint16_t src;

	ARG_UNUSED(user_data);

	ls_frame_get_payload(frame, &payload, &payload_len);
	src = ls_frame_get_src(frame);

	LOG_INF("Uplink from 0x%04x (%zu bytes): %.*s",
		src, payload_len, (int)payload_len, payload);

	if (ls_frame_get_flags(frame) & LS_FLAG_ACK_REQ) {
		ls_send_ack(ls, src);
	}

	return 0;
}

/* --------------------------------------------------------------------------
 * Main
 * -------------------------------------------------------------------------- */

int main(void)
{
	const struct device *lora_dev = DEVICE_DT_GET(DT_ALIAS(lora0));
	int ret;

	ctx = ls_init(lora_dev);
	if (!ctx) {
		LOG_ERR("ls_init failed");
		return -EIO;
	}

	ret = ls_init_coord(ctx);
	if (ret < 0) {
		LOG_ERR("ls_init_coord failed: %d", ret);
		return ret;
	}

	ls_pairing_button_set_join_cb(on_join, NULL);

	ls_register_data_cb(ctx, LS_BCAST_ADDR, on_data, NULL);

	/* Start listening for uplinks. */
	ls_mac_recv(ctx);

	LOG_INF("Coordinator ready");
	return 0;
}
```
